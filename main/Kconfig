## main/Kconfig
```kconfig
menu "Virkey.com config"

choice
    prompt "Board"
    help
        Selects Virkey target board.
    config VK_BOARD_VK1X
        bool "VIRKEY VK1X"
        help
            Selects Virkey board version 1.x.        
            GPIO 0  <-  Factory reset / Boot loader
            GPIO 18 ->  Actuator 0 (Relay 1)
            GPIO  5 ->  Actuator 1 (Relay 2)
            GPIO 32 ->  Status led (board led)
            GPIO 26 <-  Monitor 0 (Input 1)
            GPIO 27 <-  Monitor 1 (Input 2)
            GPIO 19 ->  Buzzer
            GPIO 16 ->  I2C SCL
            GPIO 13 <-> I2C SDA
            RTC DS1672
    config VK_BOARD_OLIMEX_EVB
        bool "OLIMEX ESP32 EVB"
        help
            Selects Olimex ESP32 evaluation board.
            GPIO 0  <-  Factory reset / Boot loader
            GPIO 32 ->  Actuator 0 (Relay 1)
            GPIO 33 ->  Actuator 1 (Relay 2)
            GPIO 16 ->  I2C SCL
            GPIO 13 <-> I2C SDA
            RTC PCF8563
            https://www.olimex.com/Products/IoT/ESP32-EVB/open-source-hardware
    config VK_BOARD_DIYMALL_RELAY32
        bool "DIYMALL RELAY32"
        help
            Selects DIYMALL RELAY32 board.
            GPIO 0  <- Factory reset / Boot loader
            GPIO 16 -> Actuator 0 (Relay 1)
            GPIO 17 -> Actuator 1 (Relay 2)
            GPIO 18 -> Actuator 2 (Relay 3)
            GPIO 19 -> Actuator 3 (Relay 4)
            http://www.diymalls.com/esp32-wifi-bluetooth-relay-module
            https://www.aliexpress.com/item/DIYmall-ESP32S-4-Channel-Wifi-Bluetooth-Relay-Module-DC6V-0-6A-600mA-Power-Adapter-US-EU/32834939625.html?spm=2114.search0604.3.2.782b3518sYhVlO
    config VK_BOARD_ARMTRONIX_QUADRELAY
        bool "ARMTRONIX QUADRELAY"
        help
            Selects Armtronix Quadrelay board.
            GPIO 0  <- Factory reset / Boot loader
            GPIO 2  -> Status LED (board led)
            GPIO 4  -> Actuator 0 (Relay 1)
            GPIO 12 -> Actuator 1 (Relay 2)
            GPIO 13 -> Actuator 2 (Relay 3)
            GPIO 14 -> Actuator 3 (Relay 4)
            https://www.tindie.com/products/Armtronix/wifibt-esp32-quad-relay-board-amazon-alexa/
            https://github.com/armtronix/Wifi_Bt_Esp32_Quad_Relay/blob/master/Doc/A0011_Wifi_BT_Quad_Relay_Board.pdf
    config VK_BOARD_REMOTSY_DEVRELAY
        bool "REMOTSY DEVRELAY"
        help
            Selects Remotsy developer relay board.
            GPIO 0  <- Factory reset / Boot loader
            GPIO 12 -> Neopixel GRB
            GPIO 27 -> Actuator 0 (Relay 1)
            https://www.tindie.com/products/jorgeci/simple-developer-relay-board-using-the-esp32-2/
    config VK_BOARD_IOTFLAIR_4RELAY
        bool "IOTFLAIR 4RELAY"
        help
            Selects IOT Flair 4 relay board.
            GPIO 4  <- Factory reset / Boot loader
            GPIO 15 -> Status LED (board led)
            GPIO 21 -> Actuator 0 (Relay 1)
            GPIO 22 -> Actuator 1 (Relay 2)
            GPIO 18 -> Actuator 2 (Relay 3)
            GPIO 19 -> Actuator 3 (Relay 4)
            https://www.iotflair.com/projects
    config VK_BOARD_ROBOTELECTRONICS_ESP32LR20
        bool "ROBOT ELECTRONICS ESP32LR20"
        help
            Selects Robot electronics ESP32LR20 board.
            GPIO 0  <- Factory reset / Boot loader
            GPIO 23 -> Status LED (board led) (invert)
            GPIO 33 -> Actuator 0 (Relay 1)
            GPIO 25 -> Actuator 1 (Relay 2)
            https://robot-electronics.co.uk/esp32lr20.html
    config VK_BOARD_TTGO_MINI_32
        bool "TTGO MINI 32"
        help
            Selects TTGO MINI 32 board.
            GPIO 0  <- Factory reset / Boot loader
            GPIO 22 -> Actuator 0 (Relay 1)
            http://ttgobbs.com/viewthread.php?tid=14448&extra=&ordertype=1
    config VK_BOARD_TTGO_T8
        bool "TTGO T8"
        help
            Selects TTGO T8 board.
            GPIO 0  <- Factory reset / Boot loader
            GPIO 21 -> Status LED (board led)
            GPIO 32 -> Actuator 0 (Relay 1)
            GPIO 33 -> Actuator 1 (Relay 2)
            http://www.ttgobbs.com/redirect.php?tid=11915&goto=lastpost
    config VK_BOARD_GENERIC_A
        bool "GENERIC A"
        help
            Selects generic ESP32 board with free GPIO 0,2,32,33
            GPIO 0  <- Factory reset / Boot loader
            GPIO 2  -> Status LED
            GPIO 32 -> Actuator 0 (Relay 1)
            GPIO 33 -> Actuator 1 (Relay 2)
endchoice

endmenu
```

## sdkconfig.defaults
```kconfig
# Override some defaults so BT stack is enabled
# and WiFi disabled by default
CONFIG_PYTHON="python2"
CONFIG_WIFI_ENABLED=n
CONFIG_ESP32_TIME_SYSCALL_USE_FRC1=y
CONFIG_DISABLE_BASIC_ROM_CONSOLE=y

#
# Partition Table
#
CONFIG_PARTITION_TABLE_SINGLE_APP=
CONFIG_PARTITION_TABLE_TWO_OTA=
CONFIG_PARTITION_TABLE_CUSTOM=y
CONFIG_PARTITION_TABLE_CUSTOM_FILENAME="partitions.csv"
CONFIG_PARTITION_TABLE_CUSTOM_APP_BIN_OFFSET=0x10000
CONFIG_PARTITION_TABLE_FILENAME="partitions.csv"
CONFIG_APP_OFFSET=0x10000
CONFIG_ESPTOOLPY_FLASHSIZE=y
CONFIG_ESPTOOLPY_FLASHSIZE_4MB=y

#
# Bluetooth 
#
CONFIG_BT_ENABLED=y
CONFIG_GATTC_ENABLE=n
CONFIG_BLE_SMP_ENABLE=n
CONFIG_BT_ACL_CONNECTIONS=7

#
# PHY
#
CONFIG_ESP32_PHY_CALIBRATION_AND_DATA_STORAGE=n
```
